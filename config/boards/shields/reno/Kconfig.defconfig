## config/boards/shields/reno/Kconfig.defconfig
```kconfig
# Copyright (c) 2022 The ZMK Contributors
# SPDX-License-Identifier: MIT

if SHIELD_RENO_DONGLE

config ZMK_KEYBOARD_NAME
    default "RENO"
    
config ZMK_SPLIT_ROLE_CENTRAL
    default y

config ZMK_USB
    default y

endif

if SHIELD_RENO_LEFT || SHIELD_RENO_RIGHT || SHIELD_RENO_DONGLE

config ZMK_SPLIT
    default y

config ZMK_BLE
    default y

endif
```

## config/boards/shields/reno/Kconfig.shield
```kconfig
# Copyright (c) 2022 The ZMK Contributors
# SPDX-License-Identifier: MIT

config SHIELD_RENO_LEFT
    def_bool $(shields_list_contains,reno_left)

config SHIELD_RENO_RIGHT
    def_bool $(shields_list_contains,reno_right)

config SHIELD_RENO_DONGLE
    def_bool $(shields_list_contains,reno_dongle)
```
